## kernel/Kconfig
```kconfig
mainmenu "Alix Kernel Configuration"

menu "General setup"

config KLOG_TRACE
	bool "Enable kernel trace logging"
	default n
	help
	  Enables high-volume trace logging for noisy internals like memory
	  management and mapping operations. Keep this off for normal use so
	  allocator chatter does not flood the console and slow the kernel down.

endmenu
```
